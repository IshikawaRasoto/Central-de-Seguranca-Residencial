#include <SPI.h>
#include <Adafruit_GFX.h>
#include <Adafruit_PCD8544.h>

Adafruit_PCD8544 display = Adafruit_PCD8544(18,23,4,15,2);

unsigned long previousTime=0;


static const uint8_t arduino_icon[1024]  = 
{
  0xff, 0xff, 0xff, 0xff, 0xff, 0xff, 0xff, 0xff, 0xff, 0xff, 0xf0, 0xff, 0xff, 0xff, 0xff, 0xff, 
  0xff, 0xff, 0xff, 0xff, 0xff, 0xf0, 0xff, 0xff, 0xff, 0xff, 0xff, 0xff, 0xff, 0xff, 0xff, 0xff, 
  0xf0, 0xff, 0xff, 0xff, 0xff, 0xff, 0xff, 0xff, 0xff, 0xff, 0xff, 0xf0, 0xff, 0xff, 0xff, 0xff, 
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  0xff, 0xff, 0xff, 0xff, 0xf0, 0xff, 0xff, 0xff, 0xff, 0xff, 0xff, 0xff, 0xff, 0xff, 0xff, 0xf0
};

static const uint8_t alarm_icon[1024] = 
{
  0x00, 0x00, 0x00, 0x00, 0x00, 0x00, 0x00, 0x00, 0x00, 0x00, 0x60, 0x00, 0x00, 0xf0, 0x00, 0x01, 
  0xf8, 0x00, 0x03, 0xfc, 0x00, 0x03, 0xfc, 0x00, 0x03, 0xfc, 0x00, 0x63, 0xfc, 0x60, 0x53, 0xfc, 
  0xa0, 0xf7, 0xfe, 0xf0, 0xaf, 0xff, 0x50, 0xaf, 0xff, 0x50, 0xf3, 0xfc, 0xf0, 0x70, 0x00, 0xe0, 
  0x60, 0x00, 0x60, 0x00, 0x00, 0x00, 0x00, 0x00, 0x00, 0x00, 0x00, 0x00
};

static const uint8_t wifi_icon[1024] = 
{
 0x00, 0x00, 0x00, 0x00, 0x00, 0x00, 0x01, 0xf8, 0x00, 0x0f, 0xfe, 0x00, 0x1f, 0xff, 0x80, 0x7c, 
  0x03, 0xc0, 0x70, 0x00, 0xe0, 0x63, 0xf8, 0x40, 0x07, 0xfe, 0x00, 0x0f, 0x1f, 0x00, 0x0c, 0x07, 
  0x00, 0x00, 0x60, 0x00, 0x01, 0xf8, 0x00, 0x03, 0xf8, 0x00, 0x01, 0x10, 0x00, 0x00, 0x00, 0x00, 
  0x00, 0x60, 0x00, 0x00, 0x60, 0x00, 0x00, 0x00, 0x00, 0x00, 0x00, 0x00
};

static const uint8_t calendar_icon[1024] = 
{
  0x06, 0x06, 0x00, 0x06, 0x06, 0x00, 0x1f, 0xff, 0x80, 0x3f, 0xff, 0xc0, 0x3f, 0xff, 0xc0, 0x3f, 
  0xff, 0xc0, 0x3f, 0xff, 0xc0, 0x30, 0x00, 0xc0, 0x37, 0x6e, 0xc0, 0x37, 0x6e, 0xc0, 0x32, 0x24, 
  0xc0, 0x33, 0x6c, 0xc0, 0x37, 0x6e, 0xc0, 0x33, 0x6c, 0xc0, 0x30, 0x00, 0xc0, 0x30, 0x00, 0xc0, 
  0x3f, 0xff, 0xc0, 0x1f, 0xff, 0x80, 0x00, 0x00, 0x00, 0x00, 0x00, 0x00
};

static const uint8_t book_icon[1024] = 
{
 0x00, 0x00, 0x00, 0x00, 0x00, 0x00, 0x01, 0xfe, 0x00, 0x3f, 0xff, 0xc0, 0xff, 0xff, 0xf0, 0xcf, 
  0xff, 0xe0, 0xc1, 0xf8, 0x20, 0xf0, 0x41, 0xf0, 0xfe, 0x4f, 0xf0, 0x7f, 0xff, 0x10, 0x40, 0xf8, 
  0x30, 0xfc, 0x21, 0xe0, 0xff, 0xff, 0xe0, 0x87, 0xfe, 0x40, 0xc1, 0xe0, 0xe0, 0xfc, 0x8f, 0xe0, 
  0x1f, 0xfe, 0x00, 0x03, 0xf0, 0x00, 0x00, 0x00, 0x00, 0x00, 0x00, 0x00
};

void status_wifi()
{
  if(verifica_wifi())
  {
    display.clearDisplay(); 
    display.setCursor(0,0); 
    display.setTextSize(1); 
    display.println("Wi-fi [OK]");   
    display.display(); 
  }

  else
  {
    display.clearDisplay(); 
    display.setCursor(0,0); 
    display.setTextSize(1); 
    display.println("Wi-fi [NOK]");   
    display.display(); 
  }

}

void setup()   
{
  Serial.begin(115200);
  display.begin();
  display.setContrast(50);
}

void loop() 
{
  currentTime = millis();

  /*
  if((currentTime - previousTime) > 6000){
    previousTime = currentTime;
    display.clearDisplay(); //Limpa a tela
    display.setCursor(0,0); //Seta onde comeca o texto
    display.setTextSize(1); //Tamanho do texto
    display.println("Wi-fi [OK]\nAlarm [OK]");   
    display.display(); //Transferir informacao
    display.clearDisplay();
  }
  */

  switch(notificacao)
  {
    case 1 : /*Alarme*/
    if((currentTime - previousTime) > 10000)
    {
      previousTime = currentTime;
      display.clearDisplay();
      display.setCursor(0,0);
      display.setTextSize(0.5);
      display.println("Alarme\nDisparado!");
      display.display();
    }
    

    break;

    case 2 : /*Modo AP*/
    if((currentTime - previousTime) > 10000)
    {
      previousTime = currentTime;
      display.clearDisplay();
      display.setCursor(0,0);
      display.setTextSize(0.5);
      display.println("Em MODO AP!");
      display.display();
    }
    
    break;

    case 3 : /*Campainha*/
    if((currentTime - previousTime) > 10000)
    {
      previousTime = currentTime;
      display.clearDisplay();
      display.setCursor(0,0);
      display.setTextSize(0.5);
      display.println("Campainha!");
      display.display();
    }
    

    break;
  }
 
  /*display.clearDisplay();
  display.drawBitmap(0, 0, arduino_icon, 84, 48, 1);
  display.display();
  delay(2000);
  display.clearDisplay();

  display.drawBitmap(0, 0, wifi_icon, 20, 20, 1);
  display.drawBitmap(30, 0, alarm_icon, 20, 20, 1);
  display.setTextColor(BLACK);
  display.setCursor(0,25);
  display.setTextSize(0.5);
  display.println("Wi-fi [OK]\nAlarm [OK]");  
  display.display();
  delay(2000);
  display.clearDisplay();
 
  display.setTextColor(BLACK);
  display.setCursor(0,0);
  display.setTextSize(2);
  display.println("Teste");
  display.display();

  delay(1000);
  display.clearDisplay();
  
  display.drawBitmap(0, 0, book_icon, 20, 20, 1);
  display.setTextColor(BLACK);
  display.setCursor(0,25);
  display.setTextSize(0.5);
  display.println("Oficinas\nde\nIntegracao");
  display.display();

  delay(1000);
  display.clearDisplay();

  display.drawBitmap(0, 0, calendar_icon, 20, 20, 1);
  display.setTextColor(BLACK);
  display.setCursor(0,25);
  display.setTextSize(1);
  display.println("19\nSetembro\n2022");
  display.display();

  delay(1000);*/
}
